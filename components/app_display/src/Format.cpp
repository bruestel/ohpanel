/*
   How the panel writes values.
*/

#include "appdisplay/Format.h"

#include <algorithm>
#include <cctype>
#include <cstdio>
#include <cstdlib>
#include <cstring>
#include <vector>

namespace appdisplay {
namespace {

// texts: begin
// generated by tools/gen_texts.py from components/app_display/texts.json -- edit there
constexpr int kTextCount = 111;
/* Every language's words in the order fill_texts() reads them: C strings, in flash -- only the language
   chosen becomes a Texts (display_settings). */
const char *const kTextTable[][kTextCount] = {
    {  // en
        "On", "Off", "–", "Sunday", "Monday", "Tuesday", "Wednesday", "Thursday", "Friday", "Saturday", "Sun",
        "Mon", "Tue", "Wed", "Thu", "Fri", "Sat", "January", "February", "March", "April", "May", "June", "July",
        "August", "September", "October", "November", "December", "Jan", "Feb", "Mar", "Apr", "May", "Jun", "Jul",
        "Aug", "Sep", "Oct", "Nov", "Dec", "Panel info", "Firmware", "Display", "Uptime", "Memory", "PSRAM", "WiFi",
        "IP address", "openHAB", "design outdated", "free", "Settings", "Brightness in use", "Dimmed brightness",
        "Dim after inactivity", "never", "Reboot", "Tap again to reboot", "Starting", "Setup", "Device", "WiFi",
        "Address", "connected", "connecting...", "Volume", "Mute", "Bright", "Warmth", "Colour", "Today",
        "Tomorrow", "Network", "IPv4", "Gateway", "IPv6", "Unique local", "Link-local", "IPv6 router", "DNS",
        "Time server", "Name", "open", "closed", "opening", "closing", "up", "down", "going up", "going down",
        "retracted", "extended", "retracting", "extending", "open", "closed", "opening", "closing", "open",
        "closed", "opening", "closing", "open", "closed", "opening", "closing", "All", "Target", "heating",
        "cooling",
    },
    {  // de
        "An", "Aus", "–", "Sonntag", "Montag", "Dienstag", "Mittwoch", "Donnerstag", "Freitag", "Samstag", "So",
        "Mo", "Di", "Mi", "Do", "Fr", "Sa", "Januar", "Februar", "März", "April", "Mai", "Juni", "Juli", "August",
        "September", "Oktober", "November", "Dezember", "Jan.", "Feb.", "März", "Apr.", "Mai", "Jun.", "Jul.",
        "Aug.", "Sept.", "Okt.", "Nov.", "Dez.", "Panel-Info", "Firmware", "Display", "Laufzeit", "Speicher",
        "PSRAM", "WLAN", "IP-Adresse", "openHAB", "Design veraltet", "frei", "Einstellungen",
        "Helligkeit bei Nutzung", "Helligkeit gedimmt", "Dimmen nach Inaktivität", "nie", "Neu starten",
        "Zum Neustart nochmal tippen", "Startet", "Einrichtung", "Gerät", "WLAN", "Adresse", "verbunden",
        "verbindet ...", "Lautstärke", "Stumm", "Hell", "Farbtemp.", "Farbe", "Heute", "Morgen", "Netzwerk", "IPv4",
        "Gateway", "IPv6", "Lokal (ULA)", "Link-local", "IPv6-Router", "DNS", "Zeitserver", "Name", "offen",
        "geschlossen", "fährt hoch", "fährt runter", "oben", "heruntergelassen", "fährt hoch", "fährt runter",
        "eingefahren", "ausgefahren", "fährt ein", "fährt aus", "offen", "zu", "öffnet", "schließt", "offen",
        "geschlossen", "öffnet", "schließt", "offen", "geschlossen", "öffnet", "schließt", "Alle", "Ziel", "heizt",
        "kühlt",
    },
    {  // fr
        "Marche", "Arrêt", "–", "dimanche", "lundi", "mardi", "mercredi", "jeudi", "vendredi", "samedi", "dim",
        "lun", "mar", "mer", "jeu", "ven", "sam", "janvier", "février", "mars", "avril", "mai", "juin", "juillet",
        "août", "septembre", "octobre", "novembre", "décembre", "jan", "fév", "mar", "avr", "mai", "juin", "juil",
        "août", "sep", "oct", "nov", "déc", "Infos du panneau", "Firmware", "Écran", "En marche", "Mémoire",
        "PSRAM", "WiFi", "Adresse IP", "openHAB", "design périmé", "libre", "Réglages", "Luminosité en usage",
        "Luminosité réduite", "Réduire après", "jamais", "Redémarrer", "Touchez encore pour redémarrer",
        "Démarrage", "Configuration", "Appareil", "WiFi", "Adresse", "connecté", "connexion...", "Volume", "Muet",
        "Lumière", "Chaleur", "Couleur", "Aujourd'hui", "Demain", "Réseau", "IPv4", "Passerelle", "IPv6",
        "Local (ULA)", "Lien local", "Routeur IPv6", "DNS", "Serveur NTP", "Nom", "ouvert", "fermé", "s'ouvre",
        "se ferme", "en haut", "en bas", "monte", "descend", "rentré", "sorti", "rentre", "sort", "ouvert", "fermé",
        "s'ouvre", "se ferme", "ouverte", "fermée", "s'ouvre", "se ferme", "ouvert", "fermé", "s'ouvre", "se ferme",
        "Tous", "Cible", "chauffe", "refroidit",
    },
    {  // es
        "Encendido", "Apagado", "–", "domingo", "lunes", "martes", "miércoles", "jueves", "viernes", "sábado",
        "dom", "lun", "mar", "mié", "jue", "vie", "sáb", "enero", "febrero", "marzo", "abril", "mayo", "junio",
        "julio", "agosto", "septiembre", "octubre", "noviembre", "diciembre", "ene", "feb", "mar", "abr", "may",
        "jun", "jul", "ago", "sep", "oct", "nov", "dic", "Info del panel", "Firmware", "Pantalla", "Activo",
        "Memoria", "PSRAM", "WiFi", "Dirección IP", "openHAB", "diseño antiguo", "libre", "Ajustes",
        "Brillo en uso", "Brillo atenuado", "Atenuar tras", "nunca", "Reiniciar", "Toca otra vez para reiniciar",
        "Iniciando", "Configuración", "Equipo", "WiFi", "Direcc.", "conectado", "conectando...", "Volumen",
        "Silencio", "Brillo", "Calidez", "Color", "Hoy", "Mañana", "Red", "IPv4", "Puerta de enlace", "IPv6",
        "Local (ULA)", "Enlace local", "Router IPv6", "DNS", "Servidor de hora", "Nombre", "abierta", "cerrada",
        "abriendo", "cerrando", "arriba", "abajo", "subiendo", "bajando", "recogido", "extendido", "recogiendo",
        "extendiendo", "abierta", "cerrada", "abriendo", "cerrando", "abierta", "cerrada", "abriendo", "cerrando",
        "abierta", "cerrada", "abriendo", "cerrando", "Todas", "Objetivo", "calentando", "enfriando",
    },
    {  // it
        "Acceso", "Spento", "–", "domenica", "lunedì", "martedì", "mercoledì", "giovedì", "venerdì", "sabato",
        "dom", "lun", "mar", "mer", "gio", "ven", "sab", "gennaio", "febbraio", "marzo", "aprile", "maggio",
        "giugno", "luglio", "agosto", "settembre", "ottobre", "novembre", "dicembre", "gen", "feb", "mar", "apr",
        "mag", "giu", "lug", "ago", "set", "ott", "nov", "dic", "Info pannello", "Firmware", "Display",
        "In funzione", "Memoria", "PSRAM", "WiFi", "Indirizzo IP", "openHAB", "design superato", "liberi",
        "Impostazioni", "Luminosità in uso", "Luminosità ridotta", "Riduci dopo", "mai", "Riavvia",
        "Tocca ancora per riavviare", "Avvio", "Configurazione", "Disposit", "WiFi", "Indir.", "connesso",
        "connessione...", "Volume", "Muto", "Luce", "Calore", "Colore", "Oggi", "Domani", "Rete", "IPv4", "Gateway",
        "IPv6", "Locale (ULA)", "Link-local", "Router IPv6", "DNS", "Server orario", "Nome", "aperta", "chiusa",
        "si apre", "si chiude", "su", "giù", "sale", "scende", "ritratta", "estesa", "rientra", "esce", "aperta",
        "chiusa", "si apre", "si chiude", "aperta", "chiusa", "si apre", "si chiude", "aperto", "chiuso", "si apre",
        "si chiude", "Tutte", "Obiettivo", "riscalda", "raffredda",
    },
    {  // nl
        "Aan", "Uit", "–", "zondag", "maandag", "dinsdag", "woensdag", "donderdag", "vrijdag", "zaterdag", "zo",
        "ma", "di", "wo", "do", "vr", "za", "januari", "februari", "maart", "april", "mei", "juni", "juli",
        "augustus", "september", "oktober", "november", "december", "jan", "feb", "mrt", "apr", "mei", "jun", "jul",
        "aug", "sep", "okt", "nov", "dec", "Paneelinfo", "Firmware", "Scherm", "Looptijd", "Geheugen", "PSRAM",
        "WiFi", "IP-adres", "openHAB", "ontwerp verouderd", "vrij", "Instellingen", "Helderheid in gebruik",
        "Helderheid gedimd", "Dimmen na", "nooit", "Herstarten", "Tik nogmaals om te herstarten", "Opstarten",
        "Instellen", "Apparaat", "WiFi", "Adres", "verbonden", "verbinden...", "Volume", "Dempen", "Helder",
        "Warmte", "Kleur", "Vandaag", "Morgen", "Netwerk", "IPv4", "Gateway", "IPv6", "Lokaal (ULA)", "Link-local",
        "IPv6-router", "DNS", "Tijdserver", "Naam", "open", "dicht", "gaat open", "gaat dicht", "boven", "beneden",
        "gaat op", "gaat neer", "ingerold", "uitgerold", "rolt in", "rolt uit", "open", "dicht", "gaat open",
        "gaat dicht", "open", "dicht", "gaat open", "gaat dicht", "open", "dicht", "gaat open", "gaat dicht",
        "Alle", "Doel", "verwarmt", "koelt",
    },
    {  // pt
        "Ligado", "Desligado", "–", "domingo", "segunda", "terça", "quarta", "quinta", "sexta", "sábado", "dom",
        "seg", "ter", "qua", "qui", "sex", "sáb", "janeiro", "fevereiro", "março", "abril", "maio", "junho",
        "julho", "agosto", "setembro", "outubro", "novembro", "dezembro", "jan", "fev", "mar", "abr", "mai", "jun",
        "jul", "ago", "set", "out", "nov", "dez", "Info do painel", "Firmware", "Ecrã", "Ligado há", "Memória",
        "PSRAM", "WiFi", "Endereço IP", "openHAB", "design antigo", "livre", "Definições", "Brilho em uso",
        "Brilho reduzido", "Reduzir após", "nunca", "Reiniciar", "Toque de novo para reiniciar", "A iniciar",
        "Configuração", "Aparelho", "WiFi", "Endereço", "ligado", "a ligar...", "Volume", "Mudo", "Brilho", "Calor",
        "Cor", "Hoje", "Amanhã", "Rede", "IPv4", "Gateway", "IPv6", "Local (ULA)", "Link-local", "Router IPv6",
        "DNS", "Servidor de hora", "Nome", "aberta", "fechada", "a abrir", "a fechar", "em cima", "em baixo",
        "a subir", "a descer", "recolhido", "estendido", "a recolher", "a estender", "aberta", "fechada", "a abrir",
        "a fechar", "aberto", "fechado", "a abrir", "a fechar", "aberto", "fechado", "a abrir", "a fechar", "Todas",
        "Alvo", "a aquecer", "a arrefecer",
    },
    {  // da
        "Til", "Fra", "–", "søndag", "mandag", "tirsdag", "onsdag", "torsdag", "fredag", "lørdag", "søn", "man",
        "tir", "ons", "tor", "fre", "lør", "januar", "februar", "marts", "april", "maj", "juni", "juli", "august",
        "september", "oktober", "november", "december", "jan", "feb", "mar", "apr", "maj", "jun", "jul", "aug",
        "sep", "okt", "nov", "dec", "Panelinfo", "Firmware", "Skærm", "Oppetid", "Hukommelse", "PSRAM", "WiFi",
        "IP-adresse", "openHAB", "design forældet", "fri", "Indstillinger", "Lysstyrke i brug", "Dæmpet lysstyrke",
        "Dæmp efter", "aldrig", "Genstart", "Tryk igen for at genstarte", "Starter", "Opsætning", "Enhed", "WiFi",
        "Adresse", "forbundet", "forbinder...", "Lydstyrke", "Lydløs", "Lys", "Varme", "Farve", "I dag", "I morgen",
        "Netværk", "IPv4", "Gateway", "IPv6", "Lokal (ULA)", "Link-local", "IPv6-router", "DNS", "Tidsserver",
        "Navn", "åben", "lukket", "åbner", "lukker", "oppe", "nede", "kører op", "kører ned", "inde", "ude",
        "kører ind", "kører ud", "åben", "lukket", "åbner", "lukker", "åben", "lukket", "åbner", "lukker", "åben",
        "lukket", "åbner", "lukker", "Alle", "Mål", "varmer", "køler",
    },
    {  // sv
        "På", "Av", "–", "söndag", "måndag", "tisdag", "onsdag", "torsdag", "fredag", "lördag", "sön", "mån", "tis",
        "ons", "tor", "fre", "lör", "januari", "februari", "mars", "april", "maj", "juni", "juli", "augusti",
        "september", "oktober", "november", "december", "jan", "feb", "mar", "apr", "maj", "jun", "jul", "aug",
        "sep", "okt", "nov", "dec", "Panelinfo", "Firmware", "Skärm", "Drifttid", "Minne", "PSRAM", "WiFi",
        "IP-adress", "openHAB", "design föråldrad", "ledigt", "Inställningar", "Ljusstyrka i bruk",
        "Dämpad ljusstyrka", "Dämpa efter", "aldrig", "Starta om", "Tryck igen för att starta om", "Startar",
        "Inställning", "Enhet", "WiFi", "Adress", "ansluten", "ansluter...", "Volym", "Ljud av", "Ljus", "Värme",
        "Färg", "Idag", "Imorgon", "Nätverk", "IPv4", "Gateway", "IPv6", "Lokal (ULA)", "Länklokal", "IPv6-router",
        "DNS", "Tidsserver", "Namn", "öppen", "stängd", "öppnar", "stänger", "uppe", "nere", "går upp", "går ner",
        "inne", "ute", "går in", "går ut", "öppen", "stängd", "öppnar", "stänger", "öppen", "stängd", "öppnar",
        "stänger", "öppen", "stängd", "öppnar", "stänger", "Alla", "Mål", "värmer", "kyler",
    },
    {  // nb
        "På", "Av", "–", "søndag", "mandag", "tirsdag", "onsdag", "torsdag", "fredag", "lørdag", "søn", "man",
        "tir", "ons", "tor", "fre", "lør", "januar", "februar", "mars", "april", "mai", "juni", "juli", "august",
        "september", "oktober", "november", "desember", "jan", "feb", "mar", "apr", "mai", "jun", "jul", "aug",
        "sep", "okt", "nov", "des", "Panelinfo", "Fastvare", "Skjerm", "Oppetid", "Minne", "PSRAM", "WiFi",
        "IP-adresse", "openHAB", "design utdatert", "ledig", "Innstillinger", "Lysstyrke i bruk",
        "Dempet lysstyrke", "Demp etter", "aldri", "Start på nytt", "Trykk igjen for å starte på nytt", "Starter",
        "Oppsett", "Enhet", "WiFi", "Adresse", "tilkoblet", "kobler til...", "Volum", "Demp", "Lys", "Varme",
        "Farge", "I dag", "I morgen", "Nettverk", "IPv4", "Gateway", "IPv6", "Lokal (ULA)", "Link-local",
        "IPv6-ruter", "DNS", "Tidsserver", "Navn", "åpen", "lukket", "åpner", "lukker", "oppe", "nede", "går opp",
        "går ned", "inne", "ute", "går inn", "går ut", "åpen", "lukket", "åpner", "lukker", "åpen", "lukket",
        "åpner", "lukker", "åpen", "lukket", "åpner", "lukker", "Alle", "Mål", "varmer", "kjøler",
    },
    {  // fi
        "Päällä", "Pois", "–", "sunnuntai", "maanantai", "tiistai", "keskiviikko", "torstai", "perjantai",
        "lauantai", "su", "ma", "ti", "ke", "to", "pe", "la", "tammikuu", "helmikuu", "maaliskuu", "huhtikuu",
        "toukokuu", "kesäkuu", "heinäkuu", "elokuu", "syyskuu", "lokakuu", "marraskuu", "joulukuu", "tammi",
        "helmi", "maalis", "huhti", "touko", "kesä", "heinä", "elo", "syys", "loka", "marras", "joulu",
        "Paneelin tiedot", "Ohjelmisto", "Näyttö", "Käyntiaika", "Muisti", "PSRAM", "WiFi", "IP-osoite", "openHAB",
        "ulkoasu vanha", "vapaa", "Asetukset", "Kirkkaus käytössä", "Himmennetty kirkkaus", "Himmennä kun",
        "ei koskaan", "Käynnistä uudelleen", "Napauta uudelleen", "Käynnistyy", "Asennus", "Laite", "WiFi",
        "Osoite", "yhdistetty", "yhdistää...", "Äänenvoimakkuus", "Mykistä", "Kirkkaus", "Lämpö", "Väri", "Tänään",
        "Huomenna", "Verkko", "IPv4", "Yhdyskäytävä", "IPv6", "Paikallinen (ULA)", "Link-local", "IPv6-reititin",
        "DNS", "Aikapalvelin", "Nimi", "auki", "kiinni", "avautuu", "sulkeutuu", "ylhäällä", "alhaalla", "nousee",
        "laskee", "sisällä", "ulkona", "menee sisään", "menee ulos", "auki", "kiinni", "avautuu", "sulkeutuu",
        "auki", "kiinni", "avautuu", "sulkeutuu", "auki", "kiinni", "avautuu", "sulkeutuu", "Kaikki", "Tavoite",
        "lämmittää", "jäähdyttää",
    },
    {  // bg
        "Вкл.", "Изкл.", "–", "неделя", "понеделник", "вторник", "сряда", "четвъртък", "петък", "събота", "нд",
        "пн", "вт", "ср", "чт", "пт", "сб", "януари", "февруари", "март", "април", "май", "юни", "юли", "август",
        "септември", "октомври", "ноември", "декември", "яну", "фев", "мар", "апр", "май", "юни", "юли", "авг",
        "сеп", "окт", "ное", "дек", "Инфо за панела", "Фърмуер", "Дисплей", "Работи", "Памет", "PSRAM", "WiFi",
        "IP адрес", "openHAB", "дизайнът е стар", "свободни", "Настройки", "Яркост при ползване",
        "Затъмнена яркост", "Затъмняване след", "никога", "Рестарт", "Докоснете пак за рестарт", "Стартира",
        "Настройка", "Уред", "WiFi", "Адрес", "свързан", "свързване...", "Сила на звука", "Без звук", "Яркост",
        "Топлина", "Цвят", "Днес", "Утре", "Мрежа", "IPv4", "Шлюз", "IPv6", "Локален (ULA)", "Link-local",
        "IPv6 рутер", "DNS", "Сървър за час", "Име", "отворена", "затворена", "отваря", "затваря", "горе", "долу",
        "вдига се", "спуска се", "прибрана", "разпъната", "прибира се", "разпъва се", "отворена", "затворена",
        "отваря", "затваря", "отворена", "затворена", "отваря", "затваря", "отворена", "затворена", "отваря",
        "затваря", "Всички", "Цел", "отоплява", "охлажда",
    },
    {  // cs
        "Zap.", "Vyp.", "–", "neděle", "pondělí", "úterý", "středa", "čtvrtek", "pátek", "sobota", "ne", "po", "út",
        "st", "čt", "pá", "so", "leden", "únor", "březen", "duben", "květen", "červen", "červenec", "srpen", "září",
        "říjen", "listopad", "prosinec", "led", "úno", "bře", "dub", "kvě", "čvn", "čvc", "srp", "zář", "říj",
        "lis", "pro", "Info o panelu", "Firmware", "Displej", "Běží", "Paměť", "PSRAM", "WiFi", "IP adresa",
        "openHAB", "zastaralý design", "volné", "Nastavení", "Jas při použití", "Ztlumený jas", "Ztlumit po",
        "nikdy", "Restartovat", "Klepněte znovu pro restart", "Spouští se", "Nastavení", "Zařízení", "WiFi",
        "Adresa", "připojeno", "připojuje...", "Hlasitost", "Ztlumit", "Jas", "Teplota", "Barva", "Dnes", "Zítra",
        "Síť", "IPv4", "Brána", "IPv6", "Lokální (ULA)", "Link-local", "IPv6 router", "DNS", "Časový server",
        "Název", "otevřeno", "zavřeno", "otevírá", "zavírá", "nahoře", "dole", "jede nahoru", "jede dolů",
        "zatažená", "vysunutá", "zatahuje", "vysouvá", "otevřeno", "zavřeno", "otevírá", "zavírá", "otevřeno",
        "zavřeno", "otevírá", "zavírá", "otevřeno", "zavřeno", "otevírá", "zavírá", "Vše", "Cíl", "topí", "chladí",
    },
    {  // el
        "Ενεργό", "Ανενεργό", "–", "Κυριακή", "Δευτέρα", "Τρίτη", "Τετάρτη", "Πέμπτη", "Παρασκευή", "Σάββατο",
        "Κυρ", "Δευ", "Τρί", "Τετ", "Πέμ", "Παρ", "Σάβ", "Ιανουάριος", "Φεβρουάριος", "Μάρτιος", "Απρίλιος",
        "Μάιος", "Ιούνιος", "Ιούλιος", "Αύγουστος", "Σεπτέμβριος", "Οκτώβριος", "Νοέμβριος", "Δεκέμβριος", "Ιαν",
        "Φεβ", "Μαρ", "Απρ", "Μαΐ", "Ιουν", "Ιουλ", "Αυγ", "Σεπ", "Οκτ", "Νοε", "Δεκ", "Πληροφορίες",
        "Υλικολογισμικό", "Οθόνη", "Λειτουργία", "Μνήμη", "PSRAM", "WiFi", "Διεύθυνση IP", "openHAB",
        "παλιό σχέδιο", "ελεύθερα", "Ρυθμίσεις", "Φωτεινότητα σε χρήση", "Μειωμένη φωτεινότητα", "Μείωση μετά από",
        "ποτέ", "Επανεκκίνηση", "Πατήστε ξανά για επανεκκίνηση", "Εκκίνηση", "Ρύθμιση", "Συσκευή", "WiFi", "Διεύθ.",
        "συνδεδεμένο", "σύνδεση...", "Ένταση", "Σίγαση", "Φως", "Θερμότητα", "Χρώμα", "Σήμερα", "Αύριο", "Δίκτυο",
        "IPv4", "Πύλη", "IPv6", "Τοπική (ULA)", "Link-local", "Δρομολογητής IPv6", "DNS", "Διακομιστής ώρας",
        "Όνομα", "ανοιχτό", "κλειστό", "ανοίγει", "κλείνει", "πάνω", "κάτω", "ανεβαίνει", "κατεβαίνει", "μαζεμένη",
        "ανοιγμένη", "μαζεύεται", "ανοίγει", "ανοιχτό", "κλειστό", "ανοίγει", "κλείνει", "ανοιχτό", "κλειστό",
        "ανοίγει", "κλείνει", "ανοιχτό", "κλειστό", "ανοίγει", "κλείνει", "Όλα", "Στόχος", "θερμαίνει", "ψύχει",
    },
    {  // et
        "Sees", "Väljas", "–", "pühapäev", "esmaspäev", "teisipäev", "kolmapäev", "neljapäev", "reede", "laupäev",
        "P", "E", "T", "K", "N", "R", "L", "jaanuar", "veebruar", "märts", "aprill", "mai", "juuni", "juuli",
        "august", "september", "oktoober", "november", "detsember", "jaan", "veebr", "märts", "apr", "mai", "juuni",
        "juuli", "aug", "sept", "okt", "nov", "dets", "Paneeli teave", "Püsivara", "Ekraan", "Tööaeg", "Mälu",
        "PSRAM", "WiFi", "IP-aadress", "openHAB", "kujundus vana", "vaba", "Seaded", "Heledus kasutusel",
        "Hämardatud heledus", "Hämarda pärast", "mitte kunagi", "Taaskäivita", "Taaskäivitamiseks puuduta uuesti",
        "Käivitub", "Seadistus", "Seade", "WiFi", "Aadress", "ühendatud", "ühendab...", "Helitugevus", "Vaigista",
        "Heledus", "Soojus", "Värv", "Täna", "Homme", "Võrk", "IPv4", "Lüüs", "IPv6", "Kohalik (ULA)", "Link-local",
        "IPv6 ruuter", "DNS", "Ajaserver", "Nimi", "avatud", "suletud", "avaneb", "sulgub", "üleval", "all",
        "tõuseb", "laskub", "sees", "väljas", "tõmbub sisse", "tuleb välja", "avatud", "suletud", "avaneb",
        "sulgub", "avatud", "suletud", "avaneb", "sulgub", "avatud", "suletud", "avaneb", "sulgub", "Kõik", "Siht",
        "kütab", "jahutab",
    },
    {  // ga
        "Air", "As", "–", "Dé Domhnaigh", "Dé Luain", "Dé Máirt", "Dé Céadaoin", "Déardaoin", "Dé hAoine",
        "Dé Sathairn", "Domh", "Luan", "Máirt", "Céad", "Déar", "Aoine", "Sath", "Eanáir", "Feabhra", "Márta",
        "Aibreán", "Bealtaine", "Meitheamh", "Iúil", "Lúnasa", "Meán Fómhair", "Deireadh Fómhair", "Samhain",
        "Nollaig", "Ean", "Feabh", "Márta", "Aib", "Beal", "Meith", "Iúil", "Lún", "MFómh", "DFómh", "Samh", "Noll",
        "Faisnéis an phainéil", "Dochtearraí", "Scáileán", "Ar siúl", "Cuimhne", "PSRAM", "WiFi", "Seoladh IP",
        "openHAB", "dearadh as dáta", "saor", "Socruithe", "Gile in úsáid", "Gile laghdaithe", "Laghdaigh tar éis",
        "riamh", "Atosaigh", "Tapáil arís chun atosú", "Ag tosú", "Socrú", "Gléas", "WiFi", "Seoladh", "ceangailte",
        "ag ceangal...", "Airde", "Balbhaigh", "Gile", "Teas", "Dath", "Inniu", "Amárach", "Líonra", "IPv4",
        "Geata", "IPv6", "Áitiúil (ULA)", "Link-local", "Ródaire IPv6", "DNS", "Freastalaí ama", "Ainm", "oscailte",
        "dúnta", "ag oscailt", "ag dúnadh", "thuas", "thíos", "ag dul suas", "ag dul síos", "istigh", "amuigh",
        "ag teacht isteach", "ag dul amach", "oscailte", "dúnta", "ag oscailt", "ag dúnadh", "oscailte", "dúnta",
        "ag oscailt", "ag dúnadh", "oscailte", "dúnta", "ag oscailt", "ag dúnadh", "Gach", "Sprioc", "ag téamh",
        "ag fuarú",
    },
    {  // hr
        "Uklj.", "Isklj.", "–", "nedjelja", "ponedjeljak", "utorak", "srijeda", "četvrtak", "petak", "subota",
        "ned", "pon", "uto", "sri", "čet", "pet", "sub", "siječanj", "veljača", "ožujak", "travanj", "svibanj",
        "lipanj", "srpanj", "kolovoz", "rujan", "listopad", "studeni", "prosinac", "sij", "velj", "ožu", "tra",
        "svi", "lip", "srp", "kol", "ruj", "lis", "stu", "pro", "Info o panelu", "Firmware", "Zaslon", "Rad",
        "Memorija", "PSRAM", "WiFi", "IP adresa", "openHAB", "dizajn zastario", "slobodno", "Postavke",
        "Svjetlina u uporabi", "Prigušena svjetlina", "Priguši nakon", "nikad", "Ponovno pokreni",
        "Dodirnite ponovno za pokretanje", "Pokreće se", "Postavljanje", "Uređaj", "WiFi", "Adresa", "povezano",
        "povezivanje...", "Glasnoća", "Utišaj", "Svjetlo", "Toplina", "Boja", "Danas", "Sutra", "Mreža", "IPv4",
        "Pristupnik", "IPv6", "Lokalna (ULA)", "Link-local", "IPv6 usmjernik", "DNS", "Poslužitelj vremena",
        "Naziv", "otvoreno", "zatvoreno", "otvara se", "zatvara se", "gore", "dolje", "diže se", "spušta se",
        "uvučena", "izvučena", "uvlači se", "izvlači se", "otvoreno", "zatvoreno", "otvara se", "zatvara se",
        "otvoreno", "zatvoreno", "otvara se", "zatvara se", "otvoreno", "zatvoreno", "otvara se", "zatvara se",
        "Sve", "Cilj", "grije", "hladi",
    },
    {  // hu
        "Be", "Ki", "–", "vasárnap", "hétfő", "kedd", "szerda", "csütörtök", "péntek", "szombat", "V", "H", "K",
        "Sze", "Cs", "P", "Szo", "január", "február", "március", "április", "május", "június", "július",
        "augusztus", "szeptember", "október", "november", "december", "jan.", "febr.", "márc.", "ápr.", "máj.",
        "jún.", "júl.", "aug.", "szept.", "okt.", "nov.", "dec.", "Panel adatai", "Firmware", "Kijelző", "Üzemidő",
        "Memória", "PSRAM", "WiFi", "IP-cím", "openHAB", "elavult dizájn", "szabad", "Beállítások",
        "Fényerő használatkor", "Tompított fényerő", "Tompítás ennyi után", "soha", "Újraindítás",
        "Koppintson újra az újraindításhoz", "Indul", "Beállítás", "Eszköz", "WiFi", "Cím", "csatlakozva",
        "csatlakozik...", "Hangerő", "Némítás", "Fényerő", "Melegség", "Szín", "Ma", "Holnap", "Hálózat", "IPv4",
        "Átjáró", "IPv6", "Helyi (ULA)", "Link-local", "IPv6 útválasztó", "DNS", "Időszerver", "Név", "nyitva",
        "zárva", "nyílik", "záródik", "fent", "lent", "felmegy", "lemegy", "behúzva", "kinyitva", "behúzódik",
        "kinyílik", "nyitva", "zárva", "nyílik", "záródik", "nyitva", "zárva", "nyílik", "záródik", "nyitva",
        "zárva", "nyílik", "záródik", "Mind", "Cél", "fűt", "hűt",
    },
    {  // lt
        "Įjungta", "Išjungta", "–", "sekmadienis", "pirmadienis", "antradienis", "trečiadienis", "ketvirtadienis",
        "penktadienis", "šeštadienis", "Sk", "Pr", "An", "Tr", "Kt", "Pn", "Št", "sausis", "vasaris", "kovas",
        "balandis", "gegužė", "birželis", "liepa", "rugpjūtis", "rugsėjis", "spalis", "lapkritis", "gruodis",
        "saus.", "vas.", "kov.", "bal.", "geg.", "birž.", "liep.", "rugp.", "rugs.", "spal.", "lapkr.", "gruod.",
        "Skydelio informacija", "Programinė įr.", "Ekranas", "Veikia", "Atmintis", "PSRAM", "WiFi", "IP adresas",
        "openHAB", "dizainas pasenęs", "laisva", "Nustatymai", "Ryškumas naudojant", "Pritemdytas ryškumas",
        "Pritemdyti po", "niekada", "Paleisti iš naujo", "Bakstelėkite dar kartą", "Paleidžiama", "Sąranka",
        "Aparatas", "WiFi", "Adresas", "prijungta", "jungiamasi...", "Garsumas", "Nutildyti", "Ryškumas", "Šiluma",
        "Spalva", "Šiandien", "Rytoj", "Tinklas", "IPv4", "Šliuzas", "IPv6", "Vietinis (ULA)", "Link-local",
        "IPv6 maršrutizatorius", "DNS", "Laiko serveris", "Pavadinimas", "atidaryta", "uždaryta", "atsidaro",
        "užsidaro", "viršuje", "apačioje", "kyla", "leidžiasi", "suvyniota", "išskleista", "suvyniojama",
        "išskleidžiama", "atidaryta", "uždaryta", "atsidaro", "užsidaro", "atidaryta", "uždaryta", "atsidaro",
        "užsidaro", "atidaryta", "uždaryta", "atsidaro", "užsidaro", "Visi", "Tikslas", "šildo", "vėsina",
    },
    {  // lv
        "Ieslēgts", "Izslēgts", "–", "svētdiena", "pirmdiena", "otrdiena", "trešdiena", "ceturtdiena", "piektdiena",
        "sestdiena", "Sv", "P", "O", "T", "C", "Pk", "S", "janvāris", "februāris", "marts", "aprīlis", "maijs",
        "jūnijs", "jūlijs", "augusts", "septembris", "oktobris", "novembris", "decembris", "janv.", "febr.",
        "marts", "apr.", "maijs", "jūn.", "jūl.", "aug.", "sept.", "okt.", "nov.", "dec.", "Paneļa informācija",
        "Programmatūra", "Displejs", "Darbojas", "Atmiņa", "PSRAM", "WiFi", "IP adrese", "openHAB",
        "dizains novecojis", "brīvs", "Iestatījumi", "Spilgtums lietošanā", "Aptumšots spilgtums", "Aptumšot pēc",
        "nekad", "Restartēt", "Pieskarieties vēlreiz, lai restartētu", "Startē", "Iestatīšana", "Ierīce", "WiFi",
        "Adrese", "savienots", "savienojas...", "Skaļums", "Klusums", "Gaišums", "Siltums", "Krāsa", "Šodien",
        "Rīt", "Tīkls", "IPv4", "Vārteja", "IPv6", "Lokālā (ULA)", "Link-local", "IPv6 maršrutētājs", "DNS",
        "Laika serveris", "Nosaukums", "atvērts", "aizvērts", "atveras", "aizveras", "augšā", "lejā", "ceļas",
        "nolaižas", "ievilkta", "izvilkta", "ievelkas", "izvelkas", "atvērts", "aizvērts", "atveras", "aizveras",
        "atvērts", "aizvērts", "atveras", "aizveras", "atvērts", "aizvērts", "atveras", "aizveras", "Visi",
        "Mērķis", "silda", "dzesē",
    },
    {  // mt
        "Mixgħul", "Mitfi", "–", "Il-Ħadd", "It-Tnejn", "It-Tlieta", "L-Erbgħa", "Il-Ħamis", "Il-Ġimgħa", "Is-Sibt",
        "Ħad", "Tne", "Tli", "Erb", "Ħam", "Ġim", "Sib", "Jannar", "Frar", "Marzu", "April", "Mejju", "Ġunju",
        "Lulju", "Awwissu", "Settembru", "Ottubru", "Novembru", "Diċembru", "Jan", "Fra", "Mar", "Apr", "Mej",
        "Ġun", "Lul", "Aww", "Set", "Ott", "Nov", "Diċ", "Info tal-pannell", "Firmware", "Skrin", "Ħin mixgħul",
        "Memorja", "PSRAM", "WiFi", "Indirizz IP", "openHAB", "disinn qadim", "ħieles", "Settings",
        "Dawl waqt l-użu", "Dawl imnaqqas", "Naqqas wara", "qatt", "Erġa' ibda", "Erġa' agħfas biex terġa' tibda",
        "Qed jibda", "Setup", "Apparat", "WiFi", "Indirizz", "konness", "qed jikkonnettja...", "Volum", "Sieket",
        "Dawl", "Sħana", "Kulur", "Illum", "Għada", "Netwerk", "IPv4", "Gateway", "IPv6", "Lokali (ULA)",
        "Link-local", "Router IPv6", "DNS", "Server tal-ħin", "Isem", "miftuħ", "magħluq", "qed jinfetaħ",
        "qed jingħalaq", "fuq", "isfel", "tielgħa", "nieżla", "miġbura", "miftuħa", "qed tinġabar", "qed tinfetaħ",
        "miftuħ", "magħluq", "qed jinfetaħ", "qed jingħalaq", "miftuħ", "magħluq", "qed jinfetaħ", "qed jingħalaq",
        "miftuħ", "magħluq", "qed jinfetaħ", "qed jingħalaq", "Kollha", "Mira", "qed isaħħan", "qed ibierd",
    },
    {  // pl
        "Wł.", "Wył.", "–", "niedziela", "poniedziałek", "wtorek", "środa", "czwartek", "piątek", "sobota", "nd",
        "pn", "wt", "śr", "cz", "pt", "sb", "styczeń", "luty", "marzec", "kwiecień", "maj", "czerwiec", "lipiec",
        "sierpień", "wrzesień", "październik", "listopad", "grudzień", "sty", "lut", "mar", "kwi", "maj", "cze",
        "lip", "sie", "wrz", "paź", "lis", "gru", "Informacje o panelu", "Firmware", "Wyświetlacz", "Czas pracy",
        "Pamięć", "PSRAM", "WiFi", "Adres IP", "openHAB", "nieaktualny projekt", "wolne", "Ustawienia",
        "Jasność w użyciu", "Jasność przyciemniona", "Przyciemnij po", "nigdy", "Uruchom ponownie",
        "Dotknij ponownie, aby uruchomić", "Uruchamianie", "Konfiguracja", "Urządz.", "WiFi", "Adres", "połączono",
        "łączenie...", "Głośność", "Wycisz", "Jasność", "Barwa", "Kolor", "Dziś", "Jutro", "Sieć", "IPv4", "Brama",
        "IPv6", "Lokalny (ULA)", "Link-local", "Router IPv6", "DNS", "Serwer czasu", "Nazwa", "otwarta",
        "zamknięta", "otwiera się", "zamyka się", "góra", "dół", "podnosi się", "opuszcza się", "zwinięta",
        "rozwinięta", "zwija się", "rozwija się", "otwarta", "zamknięta", "otwiera się", "zamyka się", "otwarta",
        "zamknięta", "otwiera się", "zamyka się", "otwarta", "zamknięta", "otwiera się", "zamyka się", "Wszystkie",
        "Cel", "grzeje", "chłodzi",
    },
    {  // ro
        "Pornit", "Oprit", "–", "duminică", "luni", "marți", "miercuri", "joi", "vineri", "sâmbătă", "dum", "lun",
        "mar", "mie", "joi", "vin", "sâm", "ianuarie", "februarie", "martie", "aprilie", "mai", "iunie", "iulie",
        "august", "septembrie", "octombrie", "noiembrie", "decembrie", "ian", "feb", "mar", "apr", "mai", "iun",
        "iul", "aug", "sep", "oct", "noi", "dec", "Info panou", "Firmware", "Ecran", "Funcționare", "Memorie",
        "PSRAM", "WiFi", "Adresă IP", "openHAB", "design depășit", "liberi", "Setări", "Luminozitate în uz",
        "Luminozitate redusă", "Reducere după", "niciodată", "Repornire", "Atingeți din nou pentru repornire",
        "Pornește", "Configurare", "Aparat", "WiFi", "Adresă", "conectat", "se conectează...", "Volum", "Mut",
        "Lumină", "Căldură", "Culoare", "Azi", "Mâine", "Rețea", "IPv4", "Gateway", "IPv6", "Local (ULA)",
        "Link-local", "Router IPv6", "DNS", "Server de timp", "Nume", "deschis", "închis", "se deschide",
        "se închide", "sus", "jos", "urcă", "coboară", "strânsă", "întinsă", "se strânge", "se întinde", "deschis",
        "închis", "se deschide", "se închide", "deschis", "închis", "se deschide", "se închide", "deschis",
        "închis", "se deschide", "se închide", "Toate", "Țintă", "încălzește", "răcește",
    },
    {  // sk
        "Zap.", "Vyp.", "–", "nedeľa", "pondelok", "utorok", "streda", "štvrtok", "piatok", "sobota", "ne", "po",
        "ut", "st", "št", "pi", "so", "január", "február", "marec", "apríl", "máj", "jún", "júl", "august",
        "september", "október", "november", "december", "jan", "feb", "mar", "apr", "máj", "jún", "júl", "aug",
        "sep", "okt", "nov", "dec", "Info o paneli", "Firmvér", "Displej", "Beží", "Pamäť", "PSRAM", "WiFi",
        "IP adresa", "openHAB", "zastaraný dizajn", "voľné", "Nastavenia", "Jas pri používaní", "Stlmený jas",
        "Stlmiť po", "nikdy", "Reštartovať", "Ťuknite znova pre reštart", "Spúšťa sa", "Nastavenie", "Zariad.",
        "WiFi", "Adresa", "pripojené", "pripája sa...", "Hlasitosť", "Stlmiť", "Jas", "Teplota", "Farba", "Dnes",
        "Zajtra", "Sieť", "IPv4", "Brána", "IPv6", "Lokálna (ULA)", "Link-local", "IPv6 smerovač", "DNS",
        "Časový server", "Názov", "otvorené", "zatvorené", "otvára sa", "zatvára sa", "hore", "dole", "ide hore",
        "ide dole", "zatiahnutá", "vysunutá", "zaťahuje sa", "vysúva sa", "otvorené", "zatvorené", "otvára sa",
        "zatvára sa", "otvorené", "zatvorené", "otvára sa", "zatvára sa", "otvorené", "zatvorené", "otvára sa",
        "zatvára sa", "Všetky", "Cieľ", "kúri", "chladí",
    },
    {  // sl
        "Vklop", "Izklop", "–", "nedelja", "ponedeljek", "torek", "sreda", "četrtek", "petek", "sobota", "ned",
        "pon", "tor", "sre", "čet", "pet", "sob", "januar", "februar", "marec", "april", "maj", "junij", "julij",
        "avgust", "september", "oktober", "november", "december", "jan", "feb", "mar", "apr", "maj", "jun", "jul",
        "avg", "sep", "okt", "nov", "dec", "Podatki o plošči", "Vdelana prog.", "Zaslon", "Delovanje", "Pomnilnik",
        "PSRAM", "WiFi", "IP naslov", "openHAB", "zastarel dizajn", "prosto", "Nastavitve", "Svetlost med uporabo",
        "Zatemnjena svetlost", "Zatemni po", "nikoli", "Znova zaženi", "Tapnite znova za ponovni zagon",
        "Zaganja se", "Nastavitev", "Naprava", "WiFi", "Naslov", "povezano", "povezovanje...", "Glasnost", "Utišaj",
        "Svetlost", "Toplina", "Barva", "Danes", "Jutri", "Omrežje", "IPv4", "Prehod", "IPv6", "Lokalni (ULA)",
        "Link-local", "IPv6 usmerjevalnik", "DNS", "Časovni strežnik", "Ime", "odprto", "zaprto", "se odpira",
        "se zapira", "zgoraj", "spodaj", "gre gor", "gre dol", "zvita", "razprta", "se zvija", "se razpira",
        "odprto", "zaprto", "se odpira", "se zapira", "odprto", "zaprto", "se odpira", "se zapira", "odprto",
        "zaprto", "se odpira", "se zapira", "Vse", "Cilj", "greje", "hladi",
    },
};
struct Language {
  const char *code;
  char decimal;        // before a number's decimals
  char group;          // between its thousands
  const char *date;    // display.date_format when it is not set
};
constexpr Language kLanguages[] = {
    {"en", '.', ',', "%a, %e %b"},
    {"de", ',', '.', "%a, %e. %b"},
    {"fr", ',', ' ', "%a %e %b"},
    {"es", ',', '.', "%a, %e %b"},
    {"it", ',', '.', "%a %e %b"},
    {"nl", ',', '.', "%a %e %b"},
    {"pt", ',', ' ', "%a, %e %b"},
    {"da", ',', '.', "%a %e. %b"},
    {"sv", ',', ' ', "%a %e %b"},
    {"nb", ',', ' ', "%a %e. %b"},
    {"fi", ',', ' ', "%a %-d.%-m."},
    {"bg", ',', ' ', "%a, %e %b"},
    {"cs", ',', ' ', "%a %e. %-m."},
    {"el", ',', '.', "%a %e %b"},
    {"et", ',', ' ', "%a %e.%-m."},
    {"ga", '.', ',', "%a %e/%-m"},
    {"hr", ',', '.', "%a %e.%-m."},
    {"hu", ',', ' ', "%b %e., %a"},
    {"lt", ',', ' ', "%a %m-%d"},
    {"lv", ',', ' ', "%a, %e. %b"},
    {"mt", '.', ',', "%a %e %b"},
    {"pl", ',', ' ', "%a %e %b"},
    {"ro", ',', '.', "%a %e %b"},
    {"sk", ',', ' ', "%a %e. %-m."},
    {"sl", ',', '.', "%a %e. %-m."},
};
void fill_texts(Texts &t, const char *const *s) {
  t.on = s[0];
  t.off = s[1];
  t.undefined = s[2];
  for (int k = 0; k < 7; k++) t.weekdays[k] = s[3 + k];
  for (int k = 0; k < 7; k++) t.weekdays_short[k] = s[10 + k];
  for (int k = 0; k < 12; k++) t.months[k] = s[17 + k];
  for (int k = 0; k < 12; k++) t.months_short[k] = s[29 + k];
  t.system_title = s[41];
  for (int k = 0; k < 8; k++) t.system[k] = s[42 + k];
  t.design_outdated = s[50];
  t.free = s[51];
  t.settings_title = s[52];
  for (int k = 0; k < 3; k++) t.settings[k] = s[53 + k];
  t.never = s[56];
  t.restart = s[57];
  t.restart_confirm = s[58];
  t.boot_starting = s[59];
  t.boot_setup = s[60];
  t.boot_device = s[61];
  t.boot_wifi = s[62];
  t.boot_address = s[63];
  t.boot_connected = s[64];
  t.boot_connecting = s[65];
  t.volume_title = s[66];
  t.mute = s[67];
  for (int k = 0; k < 3; k++) t.light_views[k] = s[68 + k];
  t.today = s[71];
  t.tomorrow = s[72];
  t.network_title = s[73];
  for (int k = 0; k < 9; k++) t.network[k] = s[74 + k];
  for (int k = 0; k < 6 * 4; k++) t.cover_words[k / 4][k % 4] = s[83 + k];
  t.cover_all = s[107];
  t.thermostat_target = s[108];
  t.heating = s[109];
  t.cooling = s[110];
}
// texts: end

struct Named {
  const char *name;
  uint16_t rgb565;
};
/* The Arduino firmware's colours. */
const Named kPalette[] = {
    {"white", 65535}, {"black", 0},     {"red", 63488},  {"green", 21920},      {"blue", 1055},
    {"yellow", 65472}, {"brown", 33280}, {"grey", 33808}, {"light-grey", 52857}, {"dark-grey", 10597},
};

template <size_t N>
void override_list(std::array<std::string, N> &out, const cJSON *list) {
  if (!cJSON_IsArray(list) || cJSON_GetArraySize(list) != static_cast<int>(N))
    return;
  size_t i = 0;
  for (const cJSON *e = list->child; e && i < N; e = e->next, i++)
    if (cJSON_IsString(e))
      out[i] = e->valuestring;
}

std::string str(const cJSON *obj, const char *key, const std::string &fallback) {
  const cJSON *v = cJSON_GetObjectItem(obj, key);
  return cJSON_IsString(v) ? v->valuestring : fallback;
}

/* Days between two times, counted in local calendar days. */
int days_between(time_t from, time_t to) {
  struct tm a, b;
  localtime_r(&from, &a);
  localtime_r(&to, &b);
  a.tm_hour = b.tm_hour = 12;  // noon: immune to DST shifts
  a.tm_min = b.tm_min = a.tm_sec = b.tm_sec = 0;
  a.tm_isdst = b.tm_isdst = -1;
  const double diff = difftime(mktime(&b), mktime(&a));
  return static_cast<int>(diff / 86400.0 + (diff >= 0 ? 0.5 : -0.5));
}

}  // namespace

namespace {

/* A number of display.screen: a number, or {"value", "item"}. */
void screen_number(const cJSON *screen, const char *key, int &value, std::string &item) {
  const cJSON *v = cJSON_GetObjectItem(screen, key);
  if (cJSON_IsObject(v)) {
    item = str(v, "item", "");
    v = cJSON_GetObjectItem(v, "value");
  }
  if (cJSON_IsNumber(v))
    value = v->valueint;
}

/* "HH:MM" as minutes of the day; -1 if it is not one. */
int minutes(const cJSON *v) {
  int h, m;
  if (!cJSON_IsString(v) || sscanf(v->valuestring, "%d:%d", &h, &m) != 2 || h < 0 || h > 23 || m < 0 || m > 59)
    return -1;
  return h * 60 + m;
}

}  // namespace

ScreenSettings screen_settings(const cJSON *screen) {
  ScreenSettings s;
  if (!cJSON_IsObject(screen))
    return s;
  screen_number(screen, "brightness", s.brightness, s.brightness_item);
  screen_number(screen, "idle_brightness", s.idle_brightness, s.idle_brightness_item);
  screen_number(screen, "idle_after", s.idle_after, s.idle_after_item);
  if (const cJSON *n = cJSON_GetObjectItem(screen, "night"); cJSON_IsObject(n)) {
    s.night_item = str(n, "item", "");
    if (s.night_item.empty()) {
      s.night_from = minutes(cJSON_GetObjectItem(n, "from"));
      s.night_to = minutes(cJSON_GetObjectItem(n, "to"));
      if (s.night_from < 0 || s.night_to < 0 || s.night_from == s.night_to)
        s.night_from = s.night_to = -1;
    }
  }
  return s;
}

bool in_night(int now, int from, int to) {
  if (from < 0 || to < 0 || from == to)
    return false;
  return from < to ? now >= from && now < to : now >= from || now < to;
}

DisplaySettings display_settings(const cJSON *d) {
  DisplaySettings s;
  // the language's words, decimal separator and date format (an unknown language: English)
  const std::string lang = str(d, "language", "en");
  size_t li = 0;
  for (size_t k = 0; k < sizeof(kLanguages) / sizeof(kLanguages[0]); k++)
    if (lang == kLanguages[k].code)
      li = k;
  fill_texts(s.texts, kTextTable[li]);
  s.decimal = kLanguages[li].decimal;
  s.group = kLanguages[li].group;
  s.date_format = str(d, "date_format", kLanguages[li].date);
  s.time_format = str(d, "time_format", s.time_format);
  s.background = str(d, "background", "");
  if (const cJSON *h = cJSON_GetObjectItem(d, "home_after"); cJSON_IsNumber(h) && h->valueint >= 0)
    s.home_after = h->valueint;
  if (const cJSON *f = cJSON_GetObjectItem(d, "page_fade"); cJSON_IsNumber(f) && f->valueint > 0)
    s.page_fade = std::min(f->valueint, 1000);
  if (const cJSON *r = cJSON_GetObjectItem(d, "cover_reveal"); cJSON_IsString(r))
    s.cover_reveal = r->valuestring;
  s.screen = screen_settings(cJSON_GetObjectItem(d, "screen"));
  const cJSON *t = cJSON_GetObjectItem(d, "texts");
  if (cJSON_IsObject(t)) {
    s.texts.on = str(t, "on", s.texts.on);
    s.texts.off = str(t, "off", s.texts.off);
    s.texts.undefined = str(t, "undefined", s.texts.undefined);
    s.texts.settings_title = str(t, "settings_title", s.texts.settings_title);
    s.texts.never = str(t, "never", s.texts.never);
    s.texts.restart = str(t, "restart", s.texts.restart);
    s.texts.restart_confirm = str(t, "restart_confirm", s.texts.restart_confirm);
    override_list(s.texts.settings, cJSON_GetObjectItem(t, "settings"));
    override_list(s.texts.weekdays, cJSON_GetObjectItem(t, "weekdays"));
    override_list(s.texts.weekdays_short, cJSON_GetObjectItem(t, "weekdays_short"));
    override_list(s.texts.months, cJSON_GetObjectItem(t, "months"));
    override_list(s.texts.months_short, cJSON_GetObjectItem(t, "months_short"));
  }
  return s;
}

std::string format_time(const std::string &format, const struct tm &t, const Texts &x) {
  std::string out;
  char buf[16];
  for (size_t i = 0; i < format.size(); i++) {
    if (format[i] != '%' || i + 1 >= format.size()) {
      out += format[i];
      continue;
    }
    char c = format[++i];
    // "%-H": the number without a leading zero
    const bool bare = c == '-' && i + 1 < format.size();
    if (bare)
      c = format[++i];
    const auto number = [&](int v) {
      snprintf(buf, sizeof(buf), bare ? "%d" : "%02d", v);
      out += buf;
    };
    switch (c) {
      case 'a': out += x.weekdays_short[t.tm_wday % 7]; break;
      case 'A': out += x.weekdays[t.tm_wday % 7]; break;
      case 'b': out += x.months_short[t.tm_mon % 12]; break;
      case 'B': out += x.months[t.tm_mon % 12]; break;
      case 'd': number(t.tm_mday); break;
      case 'e': out += std::to_string(t.tm_mday); break;
      case 'm': number(t.tm_mon + 1); break;
      case 'y': snprintf(buf, sizeof(buf), "%02d", (t.tm_year + 1900) % 100); out += buf; break;
      case 'Y': out += std::to_string(t.tm_year + 1900); break;
      case 'H': number(t.tm_hour); break;
      case 'I': number((t.tm_hour + 11) % 12 + 1); break;
      case 'M': number(t.tm_min); break;
      case 'p': out += t.tm_hour < 12 ? "AM" : "PM"; break;
      case '%': out += '%'; break;
      default: out += '%'; if (bare) out += '-'; out += c; break;
    }
  }
  return out;
}

Notification parse_notification(const std::string &value) {
  std::vector<std::string> parts;
  size_t from = 0;
  while (parts.size() < 2) {  // the text may hold "|" itself
    const size_t bar = value.find('|', from);
    if (bar == std::string::npos)
      break;
    parts.push_back(value.substr(from, bar - from));
    from = bar + 1;
  }
  parts.push_back(value.substr(from));
  const auto level = [](std::string s) {
    for (auto &c : s)
      c = static_cast<char>(std::tolower(static_cast<unsigned char>(c)));
    if (s == "info" || s == "warning" || s == "alert") return s;
    if (s == "warn") return std::string("warning");
    if (s == "error" || s == "critical") return std::string("alert");
    return std::string();
  };
  Notification n;
  if (parts.size() == 3 && level(parts[0]).empty()) {  // "title|text" with a "|" in the text
    parts[1] += "|" + parts[2];
    parts.pop_back();
  }
  if (parts.size() == 3) {
    n.level = level(parts[0]);
    n.title = parts[1];
    n.text = parts[2];
  } else if (parts.size() == 2) {
    const std::string l = level(parts[0]);
    if (!l.empty()) n.level = l;
    else n.title = parts[0];
    n.text = parts[1];
  } else {
    n.text = parts[0];
  }
  for (size_t at; (at = n.text.find("\\n")) != std::string::npos;)  // a written-out line break
    n.text.replace(at, 2, "\n");
  return n;
}

std::string nearest_palette(int c) {
  auto rgb = [](int v, int &r, int &g, int &b) { r = (v >> 11) << 3; g = ((v >> 5) & 63) << 2; b = (v & 31) << 3; };
  int r, g, b;
  rgb(c, r, g, b);
  const char *best = kPalette[0].name;
  long best_d = -1;
  for (const auto &p : kPalette) {
    int pr, pg, pb;
    rgb(p.rgb565, pr, pg, pb);
    const long d = long(pr - r) * (pr - r) + long(pg - g) * (pg - g) + long(pb - b) * (pb - b);
    if (best_d < 0 || d < best_d) {
      best_d = d;
      best = p.name;
    }
  }
  return best;
}

namespace {
int g_theme[3] = {-1, -1, -1};   // accent, text, dim
}  // namespace

void set_theme_colors(int accent, int text, int dim) {
  g_theme[0] = accent;
  g_theme[1] = text;
  g_theme[2] = dim;
}

int color565(const char *name) {
  if (!name)
    return -1;
  if (std::strcmp(name, "theme-accent") == 0) return g_theme[0];
  if (std::strcmp(name, "theme-text") == 0) return g_theme[1];
  if (std::strcmp(name, "theme-dim") == 0) return g_theme[2];
  for (const auto &p : kPalette)
    if (std::strcmp(p.name, name) == 0)
      return p.rgb565;
  if (name[0] == '#' && std::strlen(name) == 7) {
    char *end = nullptr;
    const long v = std::strtol(name + 1, &end, 16);
    if (end && *end == 0) {
      const int r = (v >> 16) & 0xFF, g = (v >> 8) & 0xFF, b = v & 0xFF;
      return ((r >> 3) << 11) | ((g >> 2) << 5) | (b >> 3);
    }
  }
  return -1;
}

int64_t state_epoch(const appoh::ItemState &s) {
  if (s.type == "DateTime") {
    // "2026-10-05T12:33:59.045289479+0200"
    struct tm t = {};
    int off_h = 0, off_m = 0;
    char sign = '+';
    if (sscanf(s.state.c_str(), "%4d-%2d-%2dT%2d:%2d:%2d", &t.tm_year, &t.tm_mon, &t.tm_mday, &t.tm_hour, &t.tm_min,
               &t.tm_sec) != 6)
      return -1;
    const size_t z = s.state.find_last_of("+-");
    if (z != std::string::npos && z > 10 && s.state.size() >= z + 5) {
      sign = s.state[z];
      sscanf(s.state.c_str() + z + 1, "%2d%2d", &off_h, &off_m);
    }
    // days since the epoch from a civil date (H. Hinnant's days_from_civil);
    // tm_year and tm_mon still hold the year and the month 1..12 as parsed
    const int m = t.tm_mon;
    const int y = t.tm_year - (m <= 2);
    const int era = (y >= 0 ? y : y - 399) / 400;
    const int yoe = y - era * 400;
    const int mp = (m + 9) % 12;
    const int doy = (153 * mp + 2) / 5 + t.tm_mday - 1;
    const int doe = yoe * 365 + yoe / 4 - yoe / 100 + doy;
    const int64_t days = static_cast<int64_t>(era) * 146097 + doe - 719468;
    int64_t epoch = days * 86400 + t.tm_hour * 3600 + t.tm_min * 60 + t.tm_sec;
    const int64_t offset = (off_h * 3600 + off_m * 60) * (sign == '-' ? -1 : 1);
    return epoch - offset;
  }
  if (s.has_numeric && s.numeric > 0)
    return static_cast<int64_t>(s.numeric);
  return -1;
}

std::string format_number(double v, int decimals, bool thousands, char decimal, char group) {
  char buf[48];
  std::snprintf(buf, sizeof(buf), "%.*f", std::clamp(decimals, 0, 6), v);
  std::string s = buf;
  if (s[0] == '-' && s.find_first_not_of("-0.") == std::string::npos)
    s.erase(0, 1);  // no "-0"
  const size_t dot = s.find('.');
  if (dot != std::string::npos)
    s[dot] = decimal;
  if (thousands) {
    const char sep = group ? group : decimal == ',' ? '.' : ',';   // 0: the other one of the two
    const size_t start = s[0] == '-' ? 1 : 0;
    for (size_t at = dot == std::string::npos ? s.size() : dot; at > start + 3; at -= 3)
      s.insert(at - 3, 1, sep);
  }
  return s;
}

std::string unit_of(const appoh::ItemState &s) {
  if (s.type == "Percent")
    return "%";
  if (!s.unit.empty())
    return s.unit;
  const size_t end = s.display.find_first_not_of("+-0123456789.,eE ");
  if (s.has_numeric && end != std::string::npos && end > 0)
    return s.display.substr(end);
  return "";
}

std::string format_pattern(const std::string &pattern, const appoh::ItemState &s, const DisplaySettings &d,
                           double factor) {
  std::string out;
  for (size_t i = 0; i < pattern.size(); i++) {
    if (pattern[i] != '%') {
      out += pattern[i];
      continue;
    }
    if (pattern.compare(i, 2, "%%") == 0) {
      out += '%';
      i++;
      continue;
    }
    if (pattern.compare(i, 6, "%unit%") == 0) {
      out += unit_of(s);
      i += 5;
      continue;
    }
    // %[,][.N](f|d|s)
    size_t j = i + 1;
    const bool thousands = j < pattern.size() && pattern[j] == ',';
    if (thousands)
      j++;
    int decimals = -1;
    if (j < pattern.size() && pattern[j] == '.') {
      size_t k = j + 1;
      decimals = 0;
      while (k < pattern.size() && std::isdigit(static_cast<unsigned char>(pattern[k])) && k < j + 3)
        decimals = decimals * 10 + (pattern[k++] - '0');
      j = k;
    }
    const char conv = j < pattern.size() ? pattern[j] : 0;
    if (conv == 's') {
      out += s.state;
    } else if (conv == 'f' || conv == 'd') {
      if (s.has_numeric)
        out += format_number(s.numeric * factor, conv == 'd' ? 0 : decimals < 0 ? 6 : decimals, thousands, d.decimal, d.group);
      else
        out += s.display;
    } else {
      out += '%';  // not a placeholder: as it is
      continue;
    }
    i = j;
  }
  return out;
}

std::string localize_number(const std::string &text, char decimal, char group) {
  if (decimal == '.' && (!group || group == ','))
    return text;
  const char thousands = group ? group : decimal == ',' ? '.' : ',';
  std::string out = text;
  const auto digit = [&](size_t i) { return i < text.size() && std::isdigit(static_cast<unsigned char>(text[i])); };
  for (size_t i = 1; i + 1 < text.size(); i++)
    if ((text[i] == '.' || text[i] == ',') && digit(i - 1) && digit(i + 1))
      out[i] = text[i] == '.' ? decimal : thousands;
  return out;
}

std::string format_state(const appoh::ItemState &s, const char *format, const DisplaySettings &d, double factor,
                         int decimals) {
  if (s.undefined())
    return d.texts.undefined;
  if (format && *format && std::strcmp(format, "date") && std::strcmp(format, "time") &&
      std::strcmp(format, "datetime"))
    return format_pattern(format, s, d, factor);  // a text without placeholders: as it is
  if ((!format || !*format) && factor != 1 && s.has_numeric)  // the unit is another one now: a pattern says it
    return format_number(s.numeric * factor, decimals, false, d.decimal);
  if (format && *format) {
    const int64_t e = state_epoch(s);
    if (e >= 0) {
      const time_t t = static_cast<time_t>(e);
      struct tm lt;
      localtime_r(&t, &lt);
      if (std::strcmp(format, "date") == 0)
        return format_time(d.date_format, lt, d.texts);
      if (std::strcmp(format, "time") == 0)
        return format_time(d.time_format, lt, d.texts);
      return format_time(d.date_format, lt, d.texts) + " " + format_time(d.time_format, lt, d.texts);
    }
  }
  // a number as openHAB wrote it, in the display language's separators (not a text: a date's dots stay)
  const bool number = s.type == "Quantity" || s.type == "Decimal" || s.type == "Percent";
  return number ? localize_number(s.display, d.decimal, d.group) : s.display;
}

namespace {
/* A rule's threshold: a number, or "@key" -- the number in `vars` under that key; false if it is neither. */
bool threshold(const cJSON *t, const cJSON *vars, double &out) {
  if (cJSON_IsNumber(t)) {
    out = t->valuedouble;
    return true;
  }
  if (!cJSON_IsString(t) || t->valuestring[0] != '@')
    return false;
  const cJSON *v = cJSON_GetObjectItem(vars, t->valuestring + 1);
  if (cJSON_IsNumber(v)) {
    out = v->valuedouble;
    return true;
  }
  char *end = nullptr;
  const char *text = cJSON_GetStringValue(v);
  out = text ? std::strtod(text, &end) : 0;
  return text && end != text;
}
}  // namespace

int clock_minutes(const char *hh_mm) {
  int h = 0, m = 0;
  char end = 0;
  if (!hh_mm || std::sscanf(hh_mm, "%d:%d%c", &h, &m, &end) != 2 || h < 0 || h > 23 || m < 0 || m > 59)
    return -1;
  return h * 60 + m;
}

RuleStyle rule_style(const cJSON *rules, const appoh::ItemState &s, time_t now, const cJSON *vars) {
  if (!cJSON_IsArray(rules))
    return {};
  for (const cJSON *r = rules->child; r; r = r->next) {
    RuleStyle color;
    color.color = color565(cJSON_GetStringValue(cJSON_GetObjectItem(r, "color")));
    if (const cJSON *b = cJSON_GetObjectItem(r, "blink"); cJSON_IsNumber(b))
      color.blink = b->valueint;
    if (const char *i = cJSON_GetStringValue(cJSON_GetObjectItem(r, "icon")))
      color.icon = i;
    color.icon_color = color565(cJSON_GetStringValue(cJSON_GetObjectItem(r, "icon_color")));
    if (const char *f = cJSON_GetStringValue(cJSON_GetObjectItem(r, "format")))
      color.format = f;
    if (const cJSON *a = cJSON_GetObjectItem(r, "active"); cJSON_IsBool(a))
      color.active = cJSON_IsTrue(a) ? 1 : 0;
    if (const char *l = cJSON_GetStringValue(cJSON_GetObjectItem(r, "layout")))
      color.layout = l;
    if (const cJSON *k = cJSON_GetObjectItem(r, "locked"); cJSON_IsBool(k))
      color.locked = cJSON_IsTrue(k) ? 1 : 0;
    if (const cJSON *f = cJSON_GetObjectItem(r, "factor"); cJSON_IsNumber(f) && f->valuedouble != 0)
      color.factor = f->valuedouble;
    const cJSON *equals = cJSON_GetObjectItem(r, "equals");
    const cJSON *within = cJSON_GetObjectItem(r, "within_days");
    const char *op = nullptr;
    const cJSON *limit = nullptr;
    for (const char *k : {"below", "above", "at_most", "at_least"})
      if ((limit = cJSON_GetObjectItem(r, k))) {
        op = k;
        break;
      }
    if (op) {
      double t = 0;
      if (s.has_numeric && !s.undefined() && threshold(limit, vars, t)) {
        const double v = s.numeric;
        const bool hit = op[0] == 'b' ? v < t : op[1] == 'b' ? v > t : std::strcmp(op, "at_most") == 0 ? v <= t : v >= t;
        if (hit) return color;
      }
    } else if (equals) {
      if (cJSON_IsString(equals) && s.state == equals->valuestring) return color;
    } else if (within) {
      const int64_t e = state_epoch(s);
      if (e >= 0) {
        const int days = days_between(now, static_cast<time_t>(e));
        /* "from": on the window's first day only from that time (the evening before), "until": on the date's own
           day only before it (the morning of) */
        struct tm t;
        localtime_r(&now, &t);
        const int minute = t.tm_hour * 60 + t.tm_min;
        const int from = clock_minutes(cJSON_GetStringValue(cJSON_GetObjectItem(r, "from")));
        const int until = clock_minutes(cJSON_GetStringValue(cJSON_GetObjectItem(r, "until")));
        if (days >= 0 && days <= within->valueint && !(days == within->valueint && from >= 0 && minute < from) &&
            !(days == 0 && until >= 0 && minute >= until))
          return color;
      }
    } else {
      return color;
    }
  }
  return {};
}

bool is_on(const appoh::ItemState &s) {
  if (s.state == "ON" || s.state == "OPEN" || s.state == "PLAY")
    return true;
  return s.has_numeric && !s.undefined() && s.numeric > 0;
}

std::string wifi_qr_text(const std::string &ssid, const std::string &password) {
  auto escaped = [](const std::string &v) {
    std::string out;
    for (char c : v) {
      if (c == '\\' || c == ';' || c == ',' || c == ':' || c == '"')
        out += '\\';
      out += c;
    }
    return out;
  };
  if (password.empty())  // an open network: no type at all (the spec's "omit for no password") -- shorter, so
    return "WIFI:S:" + escaped(ssid) + ";;";   // the code has fewer modules, larger on the boot page
  return "WIFI:T:WPA;S:" + escaped(ssid) + ";P:" + escaped(password) + ";;";
}

}  // namespace appdisplay
